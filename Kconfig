## Kconfig
```kconfig
# Color definitions to use with color settings
COLOR_BLACK   := 0x000000
COLOR_RED     := 0xFF0000
COLOR_GREEN   := 0x00FF00
COLOR_YELLOW  := 0xFFFF00
COLOR_BLUE    := 0x0000FF
COLOR_MAGENTA := 0xFF00FF
COLOR_CYAN    := 0x00FFFF
COLOR_WHITE   := 0xFFFFFF

config RGBLED_WIDGET
    bool "Enable RGB LED widget for showing battery and output status"

if RGBLED_WIDGET

config LED
    default y

config LED_PWM
    default y

config PWM
    default y

config RGBLED_WIDGET_INTERVAL_MS
    int "Minimum wait duration between two blinks in ms"
    default 500

# Battery level settings

choice RGBLED_WIDGET_BATTERY_SHOW
    prompt "Which battery levels to indicate, non-defaults only work for split centrals"

config RGBLED_WIDGET_BATTERY_SHOW_SELF
    bool "Indicate battery level from self only"

config RGBLED_WIDGET_BATTERY_SHOW_PERIPHERALS
    bool "Indicate battery levels from self and peripherals (if split central)"
    depends on (ZMK_SPLIT && ZMK_SPLIT_ROLE_CENTRAL)
    select ZMK_SPLIT_BLE_CENTRAL_BATTERY_LEVEL_FETCHING

config RGBLED_WIDGET_BATTERY_SHOW_ONLY_PERIPHERALS
    bool "Indicate battery levels from peripherals only (if split central)"
    depends on (ZMK_SPLIT && ZMK_SPLIT_ROLE_CENTRAL)
    select ZMK_SPLIT_BLE_CENTRAL_BATTERY_LEVEL_FETCHING

endchoice

config RGBLED_WIDGET_BATTERY_BLINK_MS
    int "Duration of battery level blink in ms"
    default 2000

config RGBLED_WIDGET_BATTERY_LEVEL_HIGH
    int "High battery level percentage"
    default 80

config RGBLED_WIDGET_BATTERY_LEVEL_LOW
    int "Low battery level percentage"
    default 20

config RGBLED_WIDGET_BATTERY_LEVEL_CRITICAL
    int "Critical battery level percentage"
    default 5

config RGBLED_WIDGET_BATTERY_COLOR_HIGH
    hex "Color for high battery level (above LEVEL_HIGH)"

    default $(COLOR_GREEN)

config RGBLED_WIDGET_BATTERY_COLOR_MEDIUM
    hex "Color for medium battery level (between LEVEL_LOW and LEVEL_HIGH)"

    default $(COLOR_YELLOW)

config RGBLED_WIDGET_BATTERY_COLOR_LOW
    hex "Color for low battery level (below LEVEL_LOW)"

    default $(COLOR_RED)

config RGBLED_WIDGET_BATTERY_COLOR_CRITICAL
    hex "Color for critical battery level (below LEVEL_CRITICAL)"

    default $(COLOR_RED)

config RGBLED_WIDGET_BATTERY_COLOR_MISSING
    hex "Color for battery not detected, or peripheral disconnected"

    default $(COLOR_MAGENTA)

# Connectivity indicator settings
config RGBLED_WIDGET_CONN_BLINK_MS
    int "Duration of BLE connection status blink in ms"
    default RGBLED_WIDGET_OUTPUT_BLINK_MS

config RGBLED_WIDGET_CONN_SHOW_USB
    bool "Show USB indicator instead of BLE status if it has priority"

config RGBLED_WIDGET_OUTPUT_BLINK_MS  # DEPRECATED, do not use
    int
    default 1000

config RGBLED_WIDGET_CONN_COLOR_CONNECTED
    hex "Color for connected BLE connection status"

    default $(COLOR_BLUE)

config RGBLED_WIDGET_CONN_COLOR_ADVERTISING
    hex "Color for advertising BLE connection status"

    default $(COLOR_YELLOW)

config RGBLED_WIDGET_CONN_COLOR_DISCONNECTED
    hex "Color for disconnected BLE connection status"

    default $(COLOR_RED)

config RGBLED_WIDGET_CONN_COLOR_USB
    hex "Color for USB endpoint active"

    default $(COLOR_CYAN)

# Layer indicator settings
config RGBLED_WIDGET_SHOW_LAYER_CHANGE
    bool "Indicate highest active layer on each layer change with a sequence of blinks"

config RGBLED_WIDGET_LAYER_BLINK_MS
    int "Blink and wait duration for layer indicator"
    default 100

config RGBLED_WIDGET_LAYER_COLOR
    hex "Color to use for layer indicator"

    default $(COLOR_CYAN)

config RGBLED_WIDGET_LAYER_DEBOUNCE_MS
    int "Wait duration after a layer change before showing the highest active layer"
    default 100

# Constant layer color settings
config RGBLED_WIDGET_SHOW_LAYER_COLORS
    bool "Use custom colors for layers"

config RGBLED_WIDGET_LAYER_0_COLOR
    hex "Color to use for the base layer"

    default $(COLOR_BLACK)

config RGBLED_WIDGET_LAYER_1_COLOR
    hex "Color to use for layer 1"

    default $(COLOR_RED)

config RGBLED_WIDGET_LAYER_2_COLOR
    hex "Color to use for layer 2"

    default $(COLOR_GREEN)

config RGBLED_WIDGET_LAYER_3_COLOR
    hex "Color to use for layer 3"

    default $(COLOR_YELLOW)

config RGBLED_WIDGET_LAYER_4_COLOR
    hex "Color to use for layer 4"

    default $(COLOR_BLUE)

config RGBLED_WIDGET_LAYER_5_COLOR
    hex "Color to use for layer 5"

    default $(COLOR_MAGENTA)

config RGBLED_WIDGET_LAYER_6_COLOR
    hex "Color to use for layer 6"

    default $(COLOR_CYAN)

config RGBLED_WIDGET_LAYER_7_COLOR
    hex "Color to use for layer 7"

    default $(COLOR_WHITE)

config RGBLED_WIDGET_LAYER_8_COLOR
    hex "Color to use for layer 8"

    default $(COLOR_BLACK)

config RGBLED_WIDGET_LAYER_9_COLOR
    hex "Color to use for layer 9"

    default $(COLOR_BLACK)

config RGBLED_WIDGET_LAYER_10_COLOR
    hex "Color to use for layer 10"

    default $(COLOR_BLACK)

config RGBLED_WIDGET_LAYER_11_COLOR
    hex "Color to use for layer 11"

    default $(COLOR_BLACK)

config RGBLED_WIDGET_LAYER_12_COLOR
    hex "Color to use for layer 12"

    default $(COLOR_BLACK)

config RGBLED_WIDGET_LAYER_13_COLOR
    hex "Color to use for layer 13"

    default $(COLOR_BLACK)

config RGBLED_WIDGET_LAYER_14_COLOR
    hex "Color to use for layer 14"

    default $(COLOR_BLACK)

config RGBLED_WIDGET_LAYER_15_COLOR
    hex "Color to use for layer 15"

    default $(COLOR_BLACK)

config RGBLED_WIDGET_LAYER_16_COLOR
    hex "Color to use for layer 16"

    default $(COLOR_BLACK)

config RGBLED_WIDGET_LAYER_17_COLOR
    hex "Color to use for layer 17"

    default $(COLOR_BLACK)

config RGBLED_WIDGET_LAYER_18_COLOR
    hex "Color to use for layer 18"

    default $(COLOR_BLACK)

config RGBLED_WIDGET_LAYER_19_COLOR
    hex "Color to use for layer 19"

    default $(COLOR_BLACK)

config RGBLED_WIDGET_LAYER_20_COLOR
    hex "Color to use for layer 20"

    default $(COLOR_BLACK)

config RGBLED_WIDGET_LAYER_21_COLOR
    hex "Color to use for layer 21"

    default $(COLOR_BLACK)

config RGBLED_WIDGET_LAYER_22_COLOR
    hex "Color to use for layer 22"

    default $(COLOR_BLACK)

config RGBLED_WIDGET_LAYER_23_COLOR
    hex "Color to use for layer 23"

    default $(COLOR_BLACK)

config RGBLED_WIDGET_LAYER_24_COLOR
    hex "Color to use for layer 24"

    default $(COLOR_BLACK)

config RGBLED_WIDGET_LAYER_25_COLOR
    hex "Color to use for layer 25"

    default $(COLOR_BLACK)

config RGBLED_WIDGET_LAYER_26_COLOR
    hex "Color to use for layer 26"

    default $(COLOR_BLACK)

config RGBLED_WIDGET_LAYER_27_COLOR
    hex "Color to use for layer 27"

    default $(COLOR_BLACK)

config RGBLED_WIDGET_LAYER_28_COLOR
    hex "Color to use for layer 28"

    default $(COLOR_BLACK)

config RGBLED_WIDGET_LAYER_29_COLOR
    hex "Color to use for layer 29"

    default $(COLOR_BLACK)

config RGBLED_WIDGET_LAYER_30_COLOR
    hex "Color to use for layer 30"

    default $(COLOR_BLACK)

config RGBLED_WIDGET_LAYER_31_COLOR
    hex "Color to use for layer 31"

    default $(COLOR_BLACK)

endif # RGBLED_WIDGET

DT_COMPAT_ZMK_BEHAVIOR_RGBLED_WIDGET := zmk,behavior-rgbled-widget

config ZMK_BEHAVIOR_RGBLED_WIDGET
    bool
    default $(dt_compat_enabled,$(DT_COMPAT_ZMK_BEHAVIOR_RGBLED_WIDGET))
config LED_PWM
    default y
```
